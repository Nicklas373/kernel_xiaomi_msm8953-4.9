## drivers/platform/xiaomi/Kconfig
```kconfig
# Xiaomi configuration options

config MACH_XIAOMI_MSM8953
	bool "Xiaomi MSM8953"
	depends on ARCH_MSM8953
	help
	  Support for MSM8953 Xiaomi variants

menu "Xiaomi board selection"

config MACH_XIAOMI_MIDO
        bool "Mido board"
        select MACH_XIAOMI_MSM8953
        help
          Support for Xiaomi Redmi Note 4 Mido

config MACH_XIAOMI_UNKNOWN
	bool "Generic MSM8953 board"
	select MACH_XIAOMI_MSM8953
	help
	  Support for Generic MSM8953 Variants

endmenu
```
